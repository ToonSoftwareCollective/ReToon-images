## source/buildroot/configs/quby_toon1_defconfig
```kconfig
BR2_arm=y
BR2_arm926t=y
BR2_TOOLCHAIN_BUILDROOT_GLIBC=y
BR2_KERNEL_HEADERS_6_12=y
BR2_TARGET_GENERIC_HOSTNAME="toon1"
BR2_TARGET_GENERIC_ISSUE="ReToon (Toon 1)"
BR2_TARGET_GENERIC_ROOT_PASSWD="toon"
BR2_TARGET_GENERIC_GETTY_PORT="ttymxc0"
BR2_TARGET_GENERIC_GETTY_BAUDRATE_115200=y
BR2_ROOTFS_OVERLAY="board/quby/toon1/rootfs-overlay"
BR2_LINUX_KERNEL=y
BR2_LINUX_KERNEL_CUSTOM_VERSION=y
BR2_LINUX_KERNEL_CUSTOM_VERSION_VALUE="6.12.73"
BR2_LINUX_KERNEL_DEFCONFIG="imx_v4_v5"
BR2_LINUX_KERNEL_CONFIG_FRAGMENT_FILES="board/quby/toon1/kernel-fragment.config"
BR2_LINUX_KERNEL_APPENDED_UIMAGE=y
BR2_LINUX_KERNEL_UIMAGE_LOADADDR="0xa0008000"
BR2_LINUX_KERNEL_DTS_SUPPORT=y
BR2_LINUX_KERNEL_CUSTOM_DTS_PATH="board/quby/toon1/dts/imx27-toon1.dts"
BR2_LINUX_KERNEL_NEEDS_HOST_OPENSSL=y
BR2_TARGET_ROOTFS_CPIO=y
BR2_TARGET_ROOTFS_CPIO_XZ=y
BR2_TARGET_ROOTFS_CPIO_UIMAGE=y
BR2_LINUX_KERNEL_XZ=y
# BR2_TARGET_ROOTFS_TAR is not set
BR2_PACKAGE_DROPBEAR=y
BR2_PACKAGE_WPA_SUPPLICANT=y
BR2_PACKAGE_WPA_SUPPLICANT_WEXT=y
BR2_PACKAGE_WIRELESS_TOOLS=y
BR2_PACKAGE_WPA_SUPPLICANT_PASSPHRASE=y
# toon-<id>.local and .local names (Home Assistant) as on the Toon 2;
# without D-Bus here: nss-mdns talks to the daemon over its own socket
BR2_PACKAGE_AVAHI=y
BR2_PACKAGE_AVAHI_DAEMON=y
BR2_PACKAGE_NSS_MDNS=y
# BR2_PACKAGE_AVAHI_AUTOIPD is not set
BR2_PACKAGE_IW=y
BR2_PACKAGE_EVTEST=y
BR2_PACKAGE_BUSYBOX_SHOW_OTHERS=y
BR2_PACKAGE_I2C_TOOLS=y
BR2_PACKAGE_LIBGPIOD=y
BR2_PACKAGE_LIBGPIOD_TOOLS=y
BR2_PACKAGE_MTD=y
BR2_PACKAGE_LINUX_FIRMWARE=y
BR2_PACKAGE_LINUX_FIRMWARE_RALINK_RT2XX=y
BR2_PACKAGE_LINUX_FIRMWARE_MWIFIEX_USB8801=y
BR2_PACKAGE_LINUX_FIRMWARE_RTL_87XX=y
BR2_JLEVEL=2
BR2_LINUX_KERNEL_PATCH="board/quby/toon1/patches/linux"
BR2_TARGET_ROOTFS_SQUASHFS=y
BR2_TARGET_ROOTFS_SQUASHFS4_XZ=y
BR2_GLOBAL_PATCH_DIR="board/quby/toon1/package-patches"
BR2_ROOTFS_POST_BUILD_SCRIPT="board/quby/toon1/post-build.sh"
BR2_ROOTFS_POST_IMAGE_SCRIPT="board/quby/toon1/mkinitrd.sh"
BR2_PACKAGE_TOON_UI=y
# el.image: jpeg-turbo (NEON on the Toon 2; faster than libjpeg on the Toon 1 too)
BR2_PACKAGE_JPEG=y
BR2_PACKAGE_JPEG_TURBO=y
BR2_PACKAGE_LVGL=y
BR2_PACKAGE_LVGL_COLOR_DEPTH_16=y
BR2_PACKAGE_CJSON=y
BR2_PACKAGE_BUSYBOX_CONFIG_FRAGMENT_FILES="board/quby/toon1/busybox-fragment.config"
BR2_PACKAGE_MOSQUITTO_BROKER=y
BR2_PACKAGE_TOON_HUB=y
BR2_PACKAGE_TOON_BOILER=y
BR2_PACKAGE_TOON_ZWAVE=y
BR2_PACKAGE_TOON_SOUND=y
BR2_PACKAGE_R92SU=y
BR2_PACKAGE_UBOOT_TOOLS=y
# BR2_PACKAGE_UBOOT_TOOLS_MKIMAGE is not set
BR2_PACKAGE_UBOOT_TOOLS_FWPRINTENV=y
BR2_PACKAGE_ALSA_UTILS=y
BR2_PACKAGE_ALSA_UTILS_APLAY=y
BR2_PACKAGE_ALSA_UTILS_AMIXER=y
# BR2_PACKAGE_ALSA_UTILS_ALSACTL is not set
# BR2_PACKAGE_ALSA_UTILS_ALSAMIXER is not set
```

## source/buildroot/configs/quby_toon2_defconfig
```kconfig
BR2_arm=y
BR2_cortex_a9=y
BR2_ARM_ENABLE_NEON=y
BR2_ARM_ENABLE_VFP=y
BR2_ARM_FPU_VFPV3=y
BR2_PACKAGE_HOST_LINUX_HEADERS_CUSTOM_6_6=y
BR2_TOOLCHAIN_BUILDROOT_CXX=y
BR2_TARGET_GENERIC_GETTY_PORT="ttymxc3"
BR2_TARGET_GENERIC_ISSUE="Welcome to ReToon"
BR2_LINUX_KERNEL=y
BR2_LINUX_KERNEL_CUSTOM_TARBALL=y
BR2_LINUX_KERNEL_CUSTOM_TARBALL_LOCATION="$(call github,nxp-imx,linux-imx,lf-6.6.23-2.0.0)/linux-imx-lf-6.6.23-2.0.0.tar.gz"
BR2_LINUX_KERNEL_DEFCONFIG="imx_v7"
BR2_LINUX_KERNEL_CONFIG_FRAGMENT_FILES="board/quby/toon2/kernel-fragment.config"
BR2_LINUX_KERNEL_PATCH="board/quby/toon2/patches/linux"
BR2_LINUX_KERNEL_DTS_SUPPORT=y
BR2_LINUX_KERNEL_CUSTOM_DTS_DIR="board/quby/toon2/dts-overlay"
BR2_LINUX_KERNEL_NEEDS_HOST_OPENSSL=y
BR2_TARGET_ROOTFS_CPIO=y
BR2_TARGET_ROOTFS_CPIO_GZIP=y
# BR2_TARGET_ROOTFS_TAR is not set
BR2_PACKAGE_DROPBEAR=y
BR2_PACKAGE_WPA_SUPPLICANT=y
BR2_PACKAGE_WPA_SUPPLICANT_WEXT=y
BR2_PACKAGE_WIRELESS_TOOLS=y
BR2_PACKAGE_IW=y
BR2_ROOTFS_OVERLAY="board/quby/toon2/rootfs-overlay"
BR2_TARGET_GENERIC_ROOT_PASSWD="toon"
BR2_PACKAGE_ENS210=y
BR2_PACKAGE_EVTEST=y
BR2_PACKAGE_BLUEZ5_UTILS=y
BR2_PACKAGE_BLUEZ5_UTILS_CLIENT=y
BR2_PACKAGE_BLUEZ5_UTILS_TOOLS=y
BR2_PACKAGE_BLUEZ5_UTILS_DEPRECATED=y
BR2_PACKAGE_TOON_BTADDR=y
BR2_PACKAGE_GP711=y
BR2_PACKAGE_BUSYBOX_CONFIG_FRAGMENT_FILES="board/quby/toon2/busybox-fragment.config"
BR2_ROOTFS_POST_IMAGE_SCRIPT="board/quby/toon2/mkinitrd.sh"
BR2_TARGET_ROOTFS_SQUASHFS=y
BR2_TARGET_ROOTFS_SQUASHFS4_XZ=y
BR2_PACKAGE_TOON_M4=y
BR2_PACKAGE_TOON_BOILER=y
BR2_PACKAGE_TOON_HUB=y
BR2_PACKAGE_MOSQUITTO=y
BR2_PACKAGE_MOSQUITTO_BROKER=y
BR2_PACKAGE_LVGL=y
BR2_PACKAGE_CJSON=y
BR2_PACKAGE_TOON_UI=y
# el.image: jpeg-turbo (NEON on the Toon 2; faster than libjpeg on the Toon 1 too)
BR2_PACKAGE_JPEG=y
BR2_PACKAGE_JPEG_TURBO=y
BR2_PACKAGE_WPA_SUPPLICANT_PASSPHRASE=y
BR2_PACKAGE_AVAHI=y
BR2_PACKAGE_AVAHI_DAEMON=y
BR2_PACKAGE_NSS_MDNS=y
# BR2_PACKAGE_AVAHI_AUTOIPD is not set
BR2_PACKAGE_TOON_ZWAVE=y
BR2_PACKAGE_TOON_ESPHOME=y
BR2_PACKAGE_TOON_SOUND=y
BR2_PACKAGE_OT_BR_POSIX=y
```

## source/buildroot/package/ens210/Config.in
```kconfig
config BR2_PACKAGE_ENS210
	bool "ens210"
	depends on BR2_LINUX_KERNEL
	help
	  Out-of-tree IIO driver for the ScioSense ENS210
	  temperature/humidity sensor (no mainline driver).
```

## source/buildroot/package/lvgl/Config.in
```kconfig
config BR2_PACKAGE_LVGL
	bool "lvgl"
	help
	  LVGL embedded graphics library, built as a static library
	  with the framebuffer and evdev drivers and the Toon
	  configuration (package/lvgl/lv_conf.h).

	  https://lvgl.io

config BR2_PACKAGE_LVGL_COLOR_DEPTH_16
	bool "16 bits per pixel"
	depends on BR2_PACKAGE_LVGL
	help
	  Draw in RGB565 for a 16-bit framebuffer (Toon 1). Off: 32
	  bits per pixel (Toon 2).
```

## source/buildroot/package/ot-br-posix/Config.in
```kconfig
config BR2_PACKAGE_OT_BR_POSIX
	bool "ot-br-posix"
	depends on BR2_INSTALL_LIBSTDCPP
	depends on BR2_TOOLCHAIN_HAS_THREADS
	depends on BR2_TOOLCHAIN_GCC_AT_LEAST_7 # C++17
	help
	  OpenThread Border Router (otbr-agent and ot-ctl), for the
	  Toon 2's GP711 radio through gp711-rcpd. Built with
	  OpenThread's own mDNS and the REST API for Home Assistant's
	  OpenThread Border Router integration. Started by
	  S62toon-thread when the radio is set to Thread.

	  https://github.com/openthread/ot-br-posix

comment "ot-br-posix needs a toolchain w/ C++, threads, gcc >= 7"
	depends on !BR2_INSTALL_LIBSTDCPP || !BR2_TOOLCHAIN_HAS_THREADS || \
		!BR2_TOOLCHAIN_GCC_AT_LEAST_7
```

## source/buildroot/package/r92su/Config.in
```kconfig
config BR2_PACKAGE_R92SU
	bool "r92su"
	depends on BR2_LINUX_KERNEL
	help
	  cfg80211 (nl80211) driver for Realtek RTL8188SU/RTL8191SU/
	  RTL8192SU USB WiFi sticks, the Toon 1's Realtek stick. Our fork
	  of jorgecszabo/rtl8192su: built on Linux 6.12, 802.11k/v.
	  Needs the firmware rtlwifi/rtl8712u.bin (linux-firmware).

	  https://github.com/IgorYbema/rtl8192su
```

## source/retoon/gp711/Config.in
```kconfig
config BR2_PACKAGE_GP711
	bool "gp711"
	help
	  Userspace driver for the Toon 2's GreenPeak GP711 802.15.4
	  radio: the gp711 test tool and gp711-rcpd, which exposes the
	  radio as a Spinel RCP: on TCP port 6638 for host Zigbee stacks
	  (zigbee2mqtt "zoh" adapter), or on a pseudo-terminal for the
	  Thread border router (ot-br-posix).
```

## source/retoon/toon-boiler/Config.in
```kconfig
config BR2_PACKAGE_TOON_BOILER
	bool "toon-boiler"
	select BR2_PACKAGE_CJSON
	select BR2_PACKAGE_TOON_BUS
	select BR2_PACKAGE_OPENSSL
	help
	  toon-boilerd: talks to the Quby boiler module on UART1
	  (4800 8E1). Switches the module between OpenTherm and the
	  on/off contact and publishes what the module collects of the
	  OpenTherm values as retoon/boiler (and retoon/opentherm) on
	  the Toon's own MQTT broker. Also the thermostat: presets,
	  week program, pre-heating and frost protection. Or, instead
	  of the module, an ESP with an OpenTherm adapter running
	  ESPHome, over its encrypted native API.
```

## source/retoon/toon-btaddr/Config.in
```kconfig
config BR2_PACKAGE_TOON_BTADDR
	bool "toon-btaddr"
	help
	  Sets the Bluetooth public address of the Toon 2's BCM43430
	  (WiFi MAC + 1) at boot, so the kernel accepts the controller.
```

## source/retoon/toon-bus/Config.in
```kconfig
config BR2_PACKAGE_TOON_BUS
	bool "toon-bus"
	select BR2_PACKAGE_MOSQUITTO
	help
	  libtoonbus: how the ReToon programs share their state and
	  commands, over the Toon's own MQTT broker (retoon/<name>,
	  retained JSON). A static library for the other toon-*
	  packages, and the toon-bus command for scripts
	  and the web interface; "toon-bus serve" (S42toon-bus)
	  gives the web interface's browsers the bus over the
	  websocket /ws.
```

## source/retoon/toon-esphome/Config.in
```kconfig
config BR2_PACKAGE_TOON_ESPHOME
	bool "toon-esphome"
	select BR2_PACKAGE_TOON_BUS
	depends on BR2_PACKAGE_AVAHI_LIBAVAHI_CLIENT
	depends on BR2_PACKAGE_BLUEZ5_UTILS
	help
	  toon-esphomed: the ReToon as an ESPHome device for Home
	  Assistant (native API on TCP port 6053, found via mDNS) with a
	  Bluetooth proxy: BLE advertisements received by the Toon 2's own
	  radio are passed to Home Assistant's Bluetooth integrations.
```

## source/retoon/toon-hub/Config.in
```kconfig
config BR2_PACKAGE_TOON_HUB
	bool "toon-hub"
	select BR2_PACKAGE_MOSQUITTO
	select BR2_PACKAGE_MOSQUITTO_BROKER
	select BR2_PACKAGE_TOON_BUS
	help
	  toon-sensord: room temperature (two-sensor estimate),
	  humidity and light as retoon/climate on the Toon's own
	  MQTT broker.

	  toon-mqttd: publishes the sensors, the boiler values and the
	  thermostat to Home Assistant over MQTT with discovery. The
	  broker settings are read from
	  /mnt/data/toon-os/config/mqtt.conf, which is not in the image.
	  It reads the other programs' states from the Toon's own
	  broker (S41toon-broker, mosquitto on 127.0.0.1, which starts
	  itself again when it stops) and sends Home Assistant's
	  commands there.
```

## source/retoon/toon-m4/Config.in
```kconfig
config BR2_PACKAGE_TOON_M4
	bool "toon-m4"
	depends on BR2_PACKAGE_HOST_ARM_GNU_TOOLCHAIN_SUPPORTS
	select BR2_PACKAGE_TOON_BUS
	help
	  Toon 2 Cortex-M4 sensor co-processor support: the M4 firmware
	  (ultrasonic wake-on-approach + VOC air-quality), loaded at boot
	  by the kernel's remoteproc (or m4load), and toon-m4d, which polls
	  the M4's shared mailbox and publishes the VOC index
	  (retoon/voc, toon-vocd-compatible) and motion/wake state
	  (retoon/motion) on the Toon's own MQTT broker.

	  The firmware is built from src/firmware with ARM's arm-none-eabi
	  toolchain (Buildroot host package arm-gnu-toolchain).

	  The ultrasonic detector needs gapless sampling, which only the
	  dedicated M4 core provides; the VOC gets PWM-phase-aligned ADC
	  samples the same way. Replaces toon-voc (do not enable both).

comment "toon-m4 needs an x86_64 or aarch64 build host"
	depends on !BR2_PACKAGE_HOST_ARM_GNU_TOOLCHAIN_SUPPORTS
```

## source/retoon/toon-sound/Config.in
```kconfig
config BR2_PACKAGE_TOON_SOUND
	bool "toon-sound"
	help
	  toon-sound: play WAV files, tones and beeps on a ReToon, the
	  same command on both Toons (Toon 1: the audio codec through
	  aplay; Toon 2: the buzzer driven by the Cortex-M4).
```

## source/retoon/toon-ui/Config.in
```kconfig
config BR2_PACKAGE_TOON_UI
	bool "toon-ui"
	select BR2_PACKAGE_LVGL
	select BR2_PACKAGE_CJSON
	select BR2_PACKAGE_MOSQUITTO
	select BR2_PACKAGE_TOON_BUS
	select BR2_PACKAGE_OPENSSL
	select BR2_PACKAGE_LIBOPENSSL_BIN if BR2_PACKAGE_LIBOPENSSL
	select BR2_PACKAGE_LIGHTTPD		# the web interface (S51toon-web)
	select BR2_PACKAGE_LIGHTTPD_OPENSSL
	select BR2_PACKAGE_CA_CERTIFICATES
	select BR2_PACKAGE_QUICKJS
	select BR2_PACKAGE_LIBCURL
	select BR2_PACKAGE_LIBCURL_CURL	# toon-update
	select BR2_PACKAGE_JPEG		# el.image (jpeg-turbo in the defconfigs)
	help
	  The Toon screen: dashboards described in Home Assistant's
	  card format, drawn with LVGL, live over the Home Assistant
	  websocket, plus the on-screen WiFi setup and the web
	  interface for everything else.
```

## source/retoon/toon-zwave/Config.in
```kconfig
config BR2_PACKAGE_TOON_ZWAVE
	bool "toon-zwave"
	select BR2_PACKAGE_TOON_BUS
	help
	  toon-zwaved: offers the Toon 2's Z-Wave 500 controller (Serial
	  API on ttymxc1) on TCP port 6639, for Z-Wave JS in Home
	  Assistant ("tcp://<toon>:6639") or software on the Toon itself.
```
